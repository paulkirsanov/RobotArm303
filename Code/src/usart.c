#include "usart.h"

void usart_send(USART_TypeDef* USARTx, char data)
{
	while(!(USARTx->ISR & USART_ISR_TC));
	USARTx->TDR = data;
}

void usart_send_data(USART_TypeDef* USARTx, uint8_t data)
{
	while(!(USARTx->ISR & USART_ISR_TC));
	USARTx->TDR = (uint8_t)data;
}

void usart_send_string(USART_TypeDef* USARTx, char* str)
{
	int i = 0;
	while(str[i])
		usart_send(USARTx, str[i++]);
}

void usart1_init(void)
{
	RCC->AHBENR |= RCC_AHBENR_GPIOAEN;
	
	GPIOA->MODER &= ~(GPIO_MODER_MODER9 | GPIO_MODER_MODER10);
	GPIOA->MODER |= (GPIO_MODER_MODER9_1 | GPIO_MODER_MODER10_1);
	GPIOA->OSPEEDR |= (GPIO_OSPEEDER_OSPEEDR9 | GPIO_OSPEEDER_OSPEEDR10);
	
	GPIOA->AFR[1] |= 0x00000770;
	
	RCC->CFGR3 &= ~RCC_CFGR3_USART1SW;
	RCC->CFGR3 |= RCC_CFGR3_USART1SW_0;
	
	RCC->APB2ENR |= RCC_APB2ENR_USART1EN;
	
	USART1->CR1 &= ~USART_CR1_M;
	USART1->CR2 &= ~USART_CR2_STOP;
	USART1->BRR = 0x0271;
	USART1->CR1 |= USART_CR1_TE;
	USART1->CR1 |= USART_CR1_RE;
	USART1->CR1 |= USART_CR1_RXNEIE;
	
	NVIC_SetPriority(USART1_IRQn, 1);
	NVIC_EnableIRQ(USART1_IRQn);
	
	USART1->CR1 |= USART_CR1_UE;
}

void usart2_init(void)
{
	RCC->AHBENR |= RCC_AHBENR_GPIOAEN;
	
	GPIOA->MODER &= ~(GPIO_MODER_MODER2 | GPIO_MODER_MODER3);
	GPIOA->MODER |= (GPIO_MODER_MODER2_1 | GPIO_MODER_MODER3_1);
	GPIOA->OSPEEDR |= (GPIO_OSPEEDER_OSPEEDR2 | GPIO_OSPEEDER_OSPEEDR3);
	
	GPIOA->AFR[0] |= 0x00007700;
	
	RCC->CFGR3 &= ~RCC_CFGR3_USART2SW;
	RCC->CFGR3 |= RCC_CFGR3_USART2SW_0;
	
	RCC->APB1ENR |= RCC_APB1ENR_USART2EN;
	
	USART2->CR1 &= ~USART_CR1_M;
	USART2->CR2 &= ~USART_CR2_STOP;
	USART2->BRR = 0x0271;														//115200
	USART2->CR1 |= USART_CR1_TE;
	USART2->CR1 |= USART_CR1_RE;
	USART2->CR1 |= USART_CR1_RXNEIE;
	
	NVIC_SetPriority(USART2_IRQn, 0);
	NVIC_EnableIRQ(USART2_IRQn);
	
	USART2->CR1 |= USART_CR1_UE;
}

